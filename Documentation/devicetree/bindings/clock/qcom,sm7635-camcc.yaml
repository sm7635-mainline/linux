## Documentation/devicetree/bindings/clock/qcom,sm7635-camcc.yaml
```yaml
# SPDX-License-Identifier: (GPL-2.0-only OR BSD-2-Clause)
%YAML 1.2
---
$id: http://devicetree.org/schemas/clock/qcom,sm7635-camcc.yaml#
$schema: http://devicetree.org/meta-schemas/core.yaml#

title: Qualcomm Camera Clock & Reset Controller on SM7635

maintainers:
  - Danila Tikhonov <danila@jiaxyga.com>

description: |
  Qualcomm camera clock control module provides the clocks, resets and power
  domains on SM7635.

  See also: include/dt-bindings/clock/qcom,sm7635-camcc.h


properties:
  compatible:
    const: qcom,sm7635-camcc

  clocks:
    items:
      - description: Board XO source
      - description: Sleep clock source

  power-domains:
    maxItems: 1
    description:
      A phandle and PM domain specifier for the CX power domain.

  reg:
    maxItems: 1

required:
  - compatible
  - clocks
  - power-domains

unevaluatedProperties: false

examples:
  - |
    #include <dt-bindings/clock/qcom,gcc-sm7635.h>
    #include <dt-bindings/clock/qcom,rpmh.h>
    #include <dt-bindings/power/qcom,rpmhpd.h>

    clock-controller@ade0000 {
      compatible = "qcom,sm7635-camcc";
      reg = <0xade0000 0x40000>;
      clocks = <&rpmhcc RPMH_CXO_CLK>,
               <&sleep_clk>;
      power-domains = <&rpmhpd RPMHPD_CX>;
      #clock-cells = <1>;
      #reset-cells = <1>;
      #power-domain-cells = <1>;
    };
...
```

## Documentation/devicetree/bindings/clock/qcom,sm7635-dispcc.yaml
```yaml
# SPDX-License-Identifier: (GPL-2.0-only OR BSD-2-Clause)
%YAML 1.2
---
$id: http://devicetree.org/schemas/clock/qcom,sm7635-dispcc.yaml#
$schema: http://devicetree.org/meta-schemas/core.yaml#

title: Qualcomm Display Clock & Reset Controller for SM7635

maintainers:
  - Danila Tikhonov <danila@jiaxyga.com>

description: |
  Qualcomm display clock control module provides the clocks, resets and power
  domains on SM7635.

  See also:: include/dt-bindings/clock/qcom,sm7635-dispcc.h

properties:
  compatible:
    const: qcom,sm7635-dispcc

  clocks:
    items:
      - description: Board XO source
      - description: GPLL0 source from GCC
      - description: Sleep clock source
      - description: Byte clock from MDSS DSI PHY0
      - description: Pixel clock from MDSS DSI PHY0
      - description: Link clock from DP PHY
      - description: VCO DIV clock from DP PHY

  power-domains:
    maxItems: 1
    description:
      CX power domain.

required:
  - compatible
  - clocks
  - power-domains

allOf:
  - $ref: qcom,gcc.yaml#

unevaluatedProperties: false

examples:
  - |
    #include <dt-bindings/clock/qcom,sm7635-gcc.h>
    #include <dt-bindings/clock/qcom,rpmh.h>
    #include <dt-bindings/power/qcom,rpmhpd.h>

    clock-controller@af00000 {
      compatible = "qcom,sm7635-dispcc";
      reg = <0x0af00000 0x200000>;
      clocks = <&rpmhcc RPMH_CXO_CLK>,
               <&gcc GCC_DISP_GPLL0_CLK_SRC>,
               <&sleep_clk>,
               <&mdss_dsi0_phy 0>,
               <&mdss_dsi0_phy 1>,
               <&dp_phy 0>,
               <&dp_phy 1>;
      power-domains = <&rpmhpd RPMHPD_CX>;
      #clock-cells = <1>;
      #reset-cells = <1>;
      #power-domain-cells = <1>;
    };
...
```

## arch/arm64/configs/compiletest_defconfig
```kconfig
# COMPILE TEST
CONFIG_COMPILE_TEST=y

# Interconnect
CONFIG_INTERCONNECT=y
CONFIG_INTERCONNECT_QCOM_SM7635=y

# Pinctrl
CONFIG_PINCTRL=y
CONFIG_PINCTRL_MSM=y
CONFIG_PINCTRL_SM7635=y

# Clocks
CONFIG_COMMON_CLK_QCOM=y
CONFIG_SM_CAMCC_7635=y
CONFIG_SM_DISPCC_7635=y
CONFIG_SM_GCC_7635=y
CONFIG_SM_GPUCC_7635=y
CONFIG_SM_VIDEOCC_7635=y
```
